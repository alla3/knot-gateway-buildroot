## package/knot-virtual-thing/Config.in
```kconfig
config BR2_PACKAGE_KNOT_VIRTUAL_THING
	bool "knot-virtual-thing"
	select BR2_PACKAGE_LIBELL
	select BR2_PACKAGE_JSON_C
	select BR2_PACKAGE_RABBITMQ_C
	select BR2_PACKAGE_KNOT_PROTOCOL_LIB
	select BR2_PACKAGE_LIBMODBUS
	help
	  KNoT Virtual Thing provides an abstraction to interact with a cloud
	  by virtualizing a KNoT Device.
```
